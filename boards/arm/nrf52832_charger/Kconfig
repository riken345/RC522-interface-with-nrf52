## boards/arm/nrf52832_charger/Kconfig
```kconfig
# nRF52832 board configuration

# Copyright (c) 2016 Nordic Semiconductor ASA
# SPDX-License-Identifier: Apache-2.0

if BOARD_NRF52832_CHARGER

config GPIO_AS_PINRESET
	bool "GPIO as pin reset (reset button)"
	default y

endif # BOARD_NRF52832_CHARGER
```

## boards/arm/nrf52832_charger/Kconfig.board
```kconfig
# nRF52 DK NRF52832 board configuration

# Copyright (c) 2016 Nordic Semiconductor ASA
# SPDX-License-Identifier: Apache-2.0

config BOARD_NRF52832_CHARGER
	bool "NRF52832 CHARGER"
	depends on SOC_NRF52832_QFAA
```
